#include "../imperial44/imperial44.dtsi"

/ {
  chosen {
    zmk,kscan = &mock_kscan;
    zmk,physical-layout = &physical_layout;
  };

  mock_kscan: mock_kscan_0 {
    compatible = "zmk,kscan-mock";
    columns = <0>;
    rows = <0>;
    events = <0>;
  };
};

&physical_layout {
  kscan = <&mock_kscan>;
};