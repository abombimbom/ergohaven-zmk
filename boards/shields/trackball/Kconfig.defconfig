## boards/shields/trackball/Kconfig.defconfig
```kconfig
if SHIELD_TRACKBALL || SHIELD_TRACKBALL_DONGLE

config ZMK_SPLIT_ROLE_CENTRAL
    default y

config ZMK_POINTING
    default y

endif

if SHIELD_TRACKBALL

config ZMK_KEYBOARD_NAME
    default "EH TB Mini v3"

config ZMK_SPLIT
    default n

endif

if SHIELD_TRACKBALL_DONGLE

config ZMK_KEYBOARD_NAME
    default "EH TB Royal Dongle"

config ZMK_SPLIT
    default y

endif
```

## boards/shields/trackball_kscan/Kconfig.defconfig
```kconfig
if SHIELD_TRACKBALL_KSCAN

config ZMK_KEYBOARD_NAME
    default "EH I44 TB"

config ZMK_SPLIT
    default y

config ZMK_SPLIT_ROLE_CENTRAL
    default y

config ZMK_POINTING
    default y

endif
```

## boards/shields/trackball_kscan/Kconfig.shield
```kconfig
config SHIELD_TRACKBALL_KSCAN
    def_bool $(shields_list_contains,trackball_kscan)
```

## boards/shields/trackball_sensor/Kconfig.defconfig
```kconfig
if SHIELD_TRACKBALL_SENSOR

config ZMK_POINTING
    default y

config SPI
    default y

config PMW3610
    default y

endif
```

## boards/shields/trackball_sensor/Kconfig.shield
```kconfig
config SHIELD_TRACKBALL_SENSOR
    def_bool $(shields_list_contains,trackball_sensor)
```
